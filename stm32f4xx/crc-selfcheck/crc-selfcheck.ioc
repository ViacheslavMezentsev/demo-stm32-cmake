# file: crc-selfcheck.ioc
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Mcu.Family=STM32F4
Mcu.Name=STM32F411C(C-E)Ux
Mcu.Package=UFQFPN48
NVIC.PriorityGroup=NVIC_PRIORITYGROUP_4
NVIC.RCC_IRQn=true\:0\:0\:false\:false\:true\:true\:false\:true
PA1.GPIO_Label=LED_USER
PA1.Signal=GPIO_Output
PA13.Mode=Serial_Wire
PA13.Signal=SYS_JTMS-SWDIO
PA14.Mode=Serial_Wire
PA14.Signal=SYS_JTCK-SWCLK
PH0\ -\ OSC_IN.Mode=HSE-External-Oscillator
PH0\ -\ OSC_IN.Signal=RCC_OSC_IN
PH1\ -\ OSC_OUT.Mode=HSE-External-Oscillator
PH1\ -\ OSC_OUT.Signal=RCC_OSC_OUT
ProjectManager.HeapSize=0x200
ProjectManager.StackSize=0x400
ProjectManager.TargetToolchain=Makefile
RCC.48MHZClocksFreq_Value=50000000
RCC.AHBFreq_Value=100000000
RCC.APB1CLKDivider=RCC_HCLK_DIV2
RCC.APB1Freq_Value=50000000
RCC.APB1TimFreq_Value=100000000
RCC.APB2Freq_Value=100000000
RCC.APB2TimFreq_Value=100000000
RCC.CortexFreq_Value=100000000
RCC.HCLKFreq_Value=100000000
RCC.HSE_VALUE=8000000
RCC.HSI_VALUE=16000000
RCC.LSE_VALUE=32768
RCC.PLLM=8
RCC.PLLMUL=RCC_PLL_MUL9
RCC.PLLN=100
RCC.SYSCLKFreq_VALUE=100000000
RCC.SYSCLKSource=RCC_SYSCLKSOURCE_PLLCLK
RCC.USBFreq_Value=72000000
RCC.VCOOutputFreq_Value=200000000
VP_CRC_VS_CRC.Mode=CRC_Activate
board=custom

// file: Core/Src/main.c
/* USER CODE BEGIN Header */
/**
  ******************************************************************************
  * @file           : main.c
  * @brief          : Main program body
  ******************************************************************************
  * @attention
  *
  * Copyright (c) 2023 STMicroelectronics.
  * All rights reserved.
  *
  * This software is licensed under terms that can be found in the LICENSE file
  * in the root directory of this software component.
  * If no LICENSE file comes with this software, it is provided AS-IS.
  *
  ******************************************************************************
  */
#include <inttypes.h>
#include <stdio.h>
/* USER CODE END Header */
#include "main.h"
#include "crc.h"
#include "gpio.h"

void SystemClock_Config(void);

/* USER CODE BEGIN 0 */
// Объявления внешних символов из скрипта компоновщика (.ld).
extern uint32_t __checksum_start[]; /// Начало проверяемой области
extern uint32_t __checksum_end[];   /// Начало секции с CRC (тут лежит записанное значение)
extern uint32_t __checksum_size[];  /// Символ, чей АДРЕС равен размеру данных

/**
 * @brief  Выполняет проверку целостности прошивки (CRC32).
 * @param  hcrc Указатель на хендлер CRC.
 * @return 1 - целостность подтверждена, 0 - ошибка.
 */
int CheckFirmwareIntegrity(CRC_HandleTypeDef *hcrc)
{
    // 1. Получаем адрес длину данных в 32-битных словах.
    uint32_t start_addr = ( uint32_t ) __checksum_start;

    // Важно: __checksum_size - это символ, его адрес равен размеру в байтах.
    uint32_t data_len_words = ( uint32_t ) __checksum_size / sizeof( uint32_t );

    // 2. Считаем CRC от начала прошивки до начала секции .checksum
    uint32_t calc_crc = HAL_CRC_Calculate( hcrc, ( uint32_t* ) __checksum_start, data_len_words );

    // 3. Читаем эталонное значение, записанное утилитой сборки.
    uint32_t stored_crc = __checksum_end[0];

    // 4. Сравниваем.
    if ( calc_crc != stored_crc )
    {
        printf( "\n\n" );
        printf( "КРИТИЧЕСКАЯ ОШИБКА: ПРОВЕРКА ЦЕЛОСТНОСТИ КОДА НЕ ПРОЙДЕНА!\n" );
        printf( "Start Addr: 0x%08" PRIX32 "\n", start_addr );
        printf( "Length:     %" PRIu32 " bytes (%" PRIu32 " words)\n", ( uint32_t ) __checksum_size, data_len_words );
        printf( "Stored CRC: 0x%08" PRIX32 " (at 0x%08" PRIX32 ")\n", stored_crc, ( uint32_t ) __checksum_end );
        printf( "Calc CRC:   0x%08" PRIX32 "\n", calc_crc );
        printf( "Система будет остановлена.\n" );

        return HAL_ERROR;
    }

    return HAL_OK;
}

/* USER CODE END 0 */

int main(void)
{

  /* USER CODE BEGIN 1 */
  // Инициализация CRC.
  hcrc.Instance = CRC;

  if ( HAL_CRC_Init( &hcrc ) != HAL_OK ) Error_Handler();

  // Не запускаем основную логику сломанной программы.
  if ( CheckFirmwareIntegrity( &hcrc ) != HAL_OK )
  {
      Error_Handler();
  }
  /* USER CODE END 1 */

  /* MCU Configuration--------------------------------------------------------*/

  /* Reset of all peripherals, Initializes the Flash interface and the Systick. */
  HAL_Init();

  /* USER CODE BEGIN Init */
  init();
  /* USER CODE END Init */

  /* Configure the system clock */
  SystemClock_Config();

  /* Initialize all configured peripherals */
  MX_GPIO_Init();
  MX_CRC_Init();

  /* Infinite loop */
  /* USER CODE BEGIN WHILE */
  setup();

  while (1)
  {
    loop();
    /* USER CODE END WHILE */

  }
}

void SystemClock_Config(void)
{
  RCC_OscInitTypeDef RCC_OscInitStruct = {0};
  RCC_ClkInitTypeDef RCC_ClkInitStruct = {0};

  /** Configure the main internal regulator output voltage
  */
  __HAL_RCC_PWR_CLK_ENABLE();
  __HAL_PWR_VOLTAGESCALING_CONFIG(PWR_REGULATOR_VOLTAGE_SCALE1);

  /** Initializes the RCC Oscillators according to the specified parameters
  * in the RCC_OscInitTypeDef structure.
  */
  RCC_OscInitStruct.OscillatorType = RCC_OSCILLATORTYPE_HSI;
  RCC_OscInitStruct.HSIState = RCC_HSI_ON;
  RCC_OscInitStruct.HSICalibrationValue = RCC_HSICALIBRATION_DEFAULT;
  RCC_OscInitStruct.PLL.PLLState = RCC_PLL_ON;
  RCC_OscInitStruct.PLL.PLLSource = RCC_PLLSOURCE_HSI;
  RCC_OscInitStruct.PLL.PLLM = 8;
  RCC_OscInitStruct.PLL.PLLN = 100;
  RCC_OscInitStruct.PLL.PLLP = RCC_PLLP_DIV2;
  RCC_OscInitStruct.PLL.PLLQ = 4;
  if (HAL_RCC_OscConfig(&RCC_OscInitStruct) != HAL_OK)
  {
    Error_Handler();
  }

  /** Initializes the CPU, AHB and APB buses clocks
  */
  RCC_ClkInitStruct.ClockType = RCC_CLOCKTYPE_HCLK|RCC_CLOCKTYPE_SYSCLK
                              |RCC_CLOCKTYPE_PCLK1|RCC_CLOCKTYPE_PCLK2;
  RCC_ClkInitStruct.SYSCLKSource = RCC_SYSCLKSOURCE_PLLCLK;
  RCC_ClkInitStruct.AHBCLKDivider = RCC_SYSCLK_DIV1;
  RCC_ClkInitStruct.APB1CLKDivider = RCC_HCLK_DIV2;
  RCC_ClkInitStruct.APB2CLKDivider = RCC_HCLK_DIV1;

  if (HAL_RCC_ClockConfig(&RCC_ClkInitStruct, FLASH_LATENCY_3) != HAL_OK)
  {
    Error_Handler();
  }
}

void Error_Handler(void)
{
  __disable_irq();
  while (1)
  {
  }
}
